## firmware/common/logger/Kconfig
```kconfig
menu "AQ logger storage worker"

config AQ_LOGGER_WORKER_WDT
    bool "Reset the chip when the storage worker stalls"
    depends on ESP_TASK_WDT_EN
    default y
    help
        Registers the parquet-sd worker as a task watchdog user. The worker
        feeds it at every heartbeat stamp, and a 1 s supervisor timer feeds it
        on the worker's behalf while the heartbeat is younger than
        AQ_LOGGER_WORKER_WDT_TIMEOUT_S. After that the task watchdog panics,
        names parquet-sd and resets with a core dump when the image enables
        one. A worker that moves again before that period ends is recovered,
        and the original task watchdog config is restored. Three such resets
        without a healthy period in between switch the worker to warn-only
        until it stays healthy again.

config AQ_LOGGER_WORKER_WDT_TIMEOUT_S
    int "Storage worker stall timeout (seconds)"
    depends on AQ_LOGGER_WORKER_WDT
    range 15 600
    default 60
    help
        Heartbeat age that counts as a stall. The reset follows within one
        more ESP_TASK_WDT_TIMEOUT_S period. A single SD call between two
        heartbeat stamps, such as the first free-cluster count of a large
        FAT volume, must finish within this time.

config AQ_LOGGER_WORKER_WDT_HEALTHY_S
    int "Healthy period that clears the stall reset count (seconds)"
    depends on AQ_LOGGER_WORKER_WDT
    range 60 86400
    default 3600
    help
        Continuous time without an expired heartbeat after which the
        consecutive stall reset count returns to zero and a warn-only worker
        is armed again.

config AQ_LOGGER_BENCH_STALL
    bool "Bench only, the parquet bench-stall serial command"
    default n
    help
        Adds the serial command `parquet bench-stall <s>`, which blocks the
        storage worker for s seconds (1 to 3600) without stamping its
        heartbeat, or forever when s is 0. It prints
        `PARQUET BENCH stall_s=<s>` first and `PARQUET BENCH stall-end` when
        a returning stall ends. Use it to force the worker watchdog, its
        recovery and a core dump on a bench board. Turn it on only through
        tools/idf-bench-stall-sdkconfig.defaults in a separate build
        directory. Never ship an image with it, any serial user can stop
        logging with it.

endmenu
```

## firmware/common/logger/tests/compile/sdkconfig.defaults
```kconfig
CONFIG_PARTITION_TABLE_CUSTOM=n
CONFIG_PARTITION_TABLE_SINGLE_APP_LARGE=y
CONFIG_ESP_CONSOLE_UART_DEFAULT=y
CONFIG_SPIRAM=y
CONFIG_SPIRAM_MODE_OCT=y
CONFIG_SPIRAM_USE_MALLOC=y
CONFIG_LWIP_SNTP_MAX_SERVERS=3
CONFIG_LWIP_DHCP_GET_NTP_SRV=y
```

## firmware/common/runtime/Kconfig
```kconfig
menu "OpenSensor persistent diagnostics"

config OS_LOG_PERSIST_RING_BYTES
    int "PSRAM log ring bytes"
    range 4096 262144
    default 65536
    help
        Size of the no-init PSRAM log ring that LOG_TAIL streams and that
        survives a warm reboot. A board with little PSRAM lowers it in its
        sdkconfig.defaults. Used only with
        SPIRAM_ALLOW_NOINIT_SEG_EXTERNAL_MEMORY.

config OS_LOG_PERSIST_EVENT_SLOTS
    int "Disconnect event ring slots"
    range 8 255
    default 64
    help
        Number of 16 byte DisconnectEvent slots kept beside the log ring.
        DIAG sends at most 61 of them on LAN and 29 on BLE.

endmenu

menu "OpenSensor power management"

config OS_PM_DFS_MIN_MHZ
    int "DFS minimum CPU MHz"
    range 40 240
    default 80
    help
        CPU frequency with no power management lock held, applied by
        opensensor::power::configure_dfs() when the image sets PM_ENABLE. The
        ESP32-S3 accepts 40, 80, 160 or 240. At 80 MHz or more the APB clock
        stays at 80 MHz, so SPI, I2C and UART clocks do not change.

config OS_PM_DFS_MAX_MHZ
    int "DFS maximum CPU MHz"
    range 40 240
    default 240
    help
        CPU frequency while a CPU_FREQ_MAX lock is held, for example by the
        LAN task while a peer is authenticated.

endmenu
```

## firmware/common/upload/Kconfig
```kconfig
menu "OpenSensor uploader"

config OS_UPLOAD_ENABLE
    bool "Upload finalized archive files to source.coop"
    default n
    help
        Builds the uploader as enabled. Off by default. Nothing uploads
        until a board is provisioned with an API key and the integration
        work wires a session into the storage worker. Dev uploads only ever
        write below dev/opensensor-space-firmware/<board>/ (#81).

endmenu
```

## firmware/esp-idf-waveshare-sim7670g/diagnostic/sdkconfig.defaults
```kconfig
CONFIG_SPIRAM=n
CONFIG_PARTITION_TABLE_CUSTOM_FILENAME="diagnostic/partitions.csv"
```

## tools/fixtures/connectivity_compile/sdkconfig.defaults
```kconfig
CONFIG_PARTITION_TABLE_CUSTOM=n
CONFIG_PARTITION_TABLE_SINGLE_APP_LARGE=y
CONFIG_ESP_CONSOLE_UART_DEFAULT=y
CONFIG_LWIP_SNTP_MAX_SERVERS=3
CONFIG_LWIP_DHCP_GET_NTP_SRV=y
```

## tools/fixtures/waveshare_psram_probe/sdkconfig.defaults
```kconfig
CONFIG_SPIRAM=y
CONFIG_SPIRAM_MODE_OCT=y
CONFIG_SPIRAM_USE_MALLOC=y
CONFIG_ESP_CONSOLE_UART_DEFAULT=y
CONFIG_PARTITION_TABLE_CUSTOM_FILENAME="partitions.csv"
```
